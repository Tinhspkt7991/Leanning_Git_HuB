AUTOSAR XML (schema 4-2-2)
package /ActiveEcuC
  module config Port: implementation-config-variant=VARIANT-POST-BUILD, module-description=Port_Impl
    PortConfigSet
      PortContainer: PortNumberOfPortPins=1
        PortPin:
          PortPinDirection = NOT_USED
          PortPinDirectionChangeable = false
          PortPinId = 1
          PortPinInitialMode = NOT_USED
          PortPinLevelValue = NOT_USED
          PortPinMode = NOT_USED
          PortPinModeChangeable = false
      PortFilterGroupConfig
      PortGroup0
        PortPin1:
          PortPinDirectionChangeable = false
          PortPinDioAltModeChangeable = true
          PortPinModeChangeable = false
          PortPinPolaritySelect = PORT_PIN_POSITIVE_LOGIC
          PortPinOutDataSelect = PORT_PIN_OUTDT
          PortPinLevelValue = PORT_PIN_LEVEL_LOW
          PortPinSensitiveInterrupt = PORT_PIN_LEVEL_SENSITIVE
          PortPinDetectionInterrupt = PORT_PIN_ONE_EDGE
          PortPinInitialMode = DIO
          PortPinDirection = PORT_PIN_IN
          PortPinPullOption = PULL_DISABLE_PUEN2_BIT11
          PortPinPullControl = PULL_DOWN_PUD2_BIT11
        PortPin0:
          PortPinDirectionChangeable = false
          PortPinDioAltModeChangeable = true
          PortPinModeChangeable = false
          PortPinPolaritySelect = PORT_PIN_POSITIVE_LOGIC
          PortPinOutDataSelect = PORT_PIN_OUTDT
          PortPinLevelValue = PORT_PIN_LEVEL_LOW
          PortPinSensitiveInterrupt = PORT_PIN_LEVEL_SENSITIVE
          PortPinDetectionInterrupt = PORT_PIN_ONE_EDGE
          PortPinInitialMode = DIO
          PortPinDirection = PORT_PIN_IN
          PortPinPullOption = PULL_DISABLE_PUEN2_BIT10
          PortPinPullControl = PULL_DOWN_PUD2_BIT10
        PortPin2:
          PortPinDirectionChangeable = false
          PortPinDioAltModeChangeable = true
          PortPinModeChangeable = false
          PortPinPolaritySelect = PORT_PIN_POSITIVE_LOGIC
          PortPinOutDataSelect = PORT_PIN_OUTDT
          PortPinLevelValue = PORT_PIN_LEVEL_LOW
          PortPinSensitiveInterrupt = PORT_PIN_LEVEL_SENSITIVE
          PortPinDetectionInterrupt = PORT_PIN_ONE_EDGE
          PortPinInitialMode = DIO
          PortPinDirection = PORT_PIN_IN
          PortPinPullOption = PULL_DISABLE_PUEN2_BIT12
          PortPinPullControl = PULL_DOWN_PUD2_BIT12
        PortPin4:
          PortPinDirectionChangeable = false
          PortPinDioAltModeChangeable = true
          PortPinModeChangeable = false
          PortPinPolaritySelect = PORT_PIN_POSITIVE_LOGIC
          PortPinOutDataSelect = PORT_PIN_OUTDT
          PortPinLevelValue = PORT_PIN_LEVEL_LOW
          PortPinSensitiveInterrupt = PORT_PIN_LEVEL_SENSITIVE
          PortPinDetectionInterrupt = PORT_PIN_ONE_EDGE
          PortPinInitialMode = DIO
          PortPinDirection = PORT_PIN_IN
          PortPinPullOption = PULL_DISABLE_PUEN2_BIT14
          PortPinPullControl = PULL_DOWN_PUD2_BIT14
        PortPin3:
          PortPinDirectionChangeable = false
          PortPinDioAltModeChangeable = true
          PortPinModeChangeable = false
          PortPinPolaritySelect = PORT_PIN_POSITIVE_LOGIC
          PortPinOutDataSelect = PORT_PIN_OUTDT
          PortPinLevelValue = PORT_PIN_LEVEL_LOW
          PortPinSensitiveInterrupt = PORT_PIN_LEVEL_SENSITIVE
          PortPinDetectionInterrupt = PORT_PIN_ONE_EDGE
          PortPinInitialMode = DIO
          PortPinDirection = PORT_PIN_IN
          PortPinPullOption = PULL_DISABLE_PUEN2_BIT13
          PortPinPullControl = PULL_DOWN_PUD2_BIT13
        PortPin6:
          PortPinDirectionChangeable = false
          PortPinDioAltModeChangeable = true
          PortPinModeChangeable = false
          PortPinPolaritySelect = PORT_PIN_POSITIVE_LOGIC
          PortPinOutDataSelect = PORT_PIN_OUTDT
          PortPinLevelValue = PORT_PIN_LEVEL_LOW
          PortPinSensitiveInterrupt = PORT_PIN_LEVEL_SENSITIVE
          PortPinDetectionInterrupt = PORT_PIN_ONE_EDGE
          PortPinInitialMode = DIO
          PortPinDirection = PORT_PIN_IN
          PortPinPullOption = PULL_DISABLE_PUEN2_BIT16
          PortPinPullControl = PULL_DOWN_PUD2_BIT16
        PortPin5:
          PortPinDirectionChangeable = false
          PortPinDioAltModeChangeable = true
          PortPinModeChangeable = false
          PortPinPolaritySelect = PORT_PIN_POSITIVE_LOGIC
          PortPinOutDataSelect = PORT_PIN_OUTDT
          PortPinLevelValue = PORT_PIN_LEVEL_LOW
          PortPinSensitiveInterrupt = PORT_PIN_LEVEL_SENSITIVE
          PortPinDetectionInterrupt = PORT_PIN_ONE_EDGE
          PortPinInitialMode = DIO
          PortPinDirection = PORT_PIN_IN
          PortPinPullOption = PULL_DISABLE_PUEN2_BIT15
          PortPinPullControl = PULL_DOWN_PUD2_BIT15
        PortPin7:
          PortPinDirectionChangeable = false
          PortPinDioAltModeChangeable = true
          PortPinModeChangeable = false
          PortPinPolaritySelect = PORT_PIN_POSITIVE_LOGIC
          PortPinOutDataSelect = PORT_PIN_OUTDT
          PortPinLevelValue = PORT_PIN_LEVEL_LOW
          PortPinSensitiveInterrupt = PORT_PIN_LEVEL_SENSITIVE
          PortPinDetectionInterrupt = PORT_PIN_ONE_EDGE
          PortPinInitialMode = DIO
          PortPinDirection = PORT_PIN_IN
          PortPinPullOption = PULL_DISABLE_PUEN2_BIT17
          PortPinPullControl = PULL_DOWN_PUD2_BIT17
        PortPin8:
          PortPinDirectionChangeable = false
          PortPinDioAltModeChangeable = true
          PortPinModeChangeable = false
          PortPinPolaritySelect = PORT_PIN_POSITIVE_LOGIC
          PortPinOutDataSelect = PORT_PIN_OUTDT
          PortPinLevelValue = PORT_PIN_LEVEL_LOW
          PortPinSensitiveInterrupt = PORT_PIN_LEVEL_SENSITIVE
          PortPinDetectionInterrupt = PORT_PIN_ONE_EDGE
          PortPinInitialMode = DIO
          PortPinDirection = PORT_PIN_IN
          PortPinPullOption = PULL_DISABLE_PUEN2_BIT18
          PortPinPullControl = PULL_DOWN_PUD2_BIT18
        PortPin9:
          PortPinDirectionChangeable = false
          PortPinDioAltModeChangeable = true
          PortPinModeChangeable = false
          PortPinPolaritySelect = PORT_PIN_POSITIVE_LOGIC
          PortPinOutDataSelect = PORT_PIN_OUTDT
          PortPinLevelValue = PORT_PIN_LEVEL_LOW
          PortPinSensitiveInterrupt = PORT_PIN_LEVEL_SENSITIVE
          PortPinDetectionInterrupt = PORT_PIN_ONE_EDGE
          PortPinInitialMode = DIO
          PortPinDirection = PORT_PIN_IN
          PortPinPullOption = PULL_DISABLE_PUEN2_BIT19
          PortPinPullControl = PULL_DOWN_PUD2_BIT19
        PortPin10:
          PortPinDirectionChangeable = false
          PortPinDioAltModeChangeable = true
          PortPinModeChangeable = false
          PortPinPolaritySelect = PORT_PIN_POSITIVE_LOGIC
          PortPinOutDataSelect = PORT_PIN_OUTDT
          PortPinLevelValue = PORT_PIN_LEVEL_LOW
          PortPinSensitiveInterrupt = PORT_PIN_LEVEL_SENSITIVE
          PortPinDetectionInterrupt = PORT_PIN_ONE_EDGE
          PortPinInitialMode = DIO
          PortPinDirection = PORT_PIN_IN
          PortPinPullOption = PULL_DISABLE_PUEN2_BIT20
          PortPinPullControl = PULL_DOWN_PUD2_BIT20
        PortPin11:
          PortPinDirectionChangeable = false
          PortPinDioAltModeChangeable = true
          PortPinModeChangeable = false
          PortPinPolaritySelect = PORT_PIN_POSITIVE_LOGIC
          PortPinOutDataSelect = PORT_PIN_OUTDT
          PortPinLevelValue = PORT_PIN_LEVEL_LOW
          PortPinSensitiveInterrupt = PORT_PIN_LEVEL_SENSITIVE
          PortPinDetectionInterrupt = PORT_PIN_ONE_EDGE
          PortPinInitialMode = INTERRUPT
          PortPinDirection = PORT_PIN_IN
          PortPinPullOption = PULL_DISABLE_PUEN2_BIT21
          PortPinPullControl = PULL_DOWN_PUD2_BIT21
        PortPin12:
          PortPinDirectionChangeable = false
          PortPinDioAltModeChangeable = true
          PortPinModeChangeable = false
          PortPinPolaritySelect = PORT_PIN_POSITIVE_LOGIC
          PortPinOutDataSelect = PORT_PIN_OUTDT
          PortPinLevelValue = PORT_PIN_LEVEL_LOW
          PortPinSensitiveInterrupt = PORT_PIN_LEVEL_SENSITIVE
          PortPinDetectionInterrupt = PORT_PIN_ONE_EDGE
          PortPinInitialMode = INTERRUPT
          PortPinDirection = PORT_PIN_IN
          PortPinPullOption = PULL_DISABLE_PUEN2_BIT22
          PortPinPullControl = PULL_DOWN_PUD2_BIT22
        PortPin13:
          PortPinDirectionChangeable = false
          PortPinDioAltModeChangeable = true
          PortPinModeChangeable = false
          PortPinPolaritySelect = PORT_PIN_POSITIVE_LOGIC
          PortPinOutDataSelect = PORT_PIN_OUTDT
          PortPinLevelValue = PORT_PIN_LEVEL_LOW
          PortPinSensitiveInterrupt = PORT_PIN_LEVEL_SENSITIVE
          PortPinDetectionInterrupt = PORT_PIN_ONE_EDGE
          PortPinInitialMode = INTERRUPT
          PortPinDirection = PORT_PIN_IN
          PortPinPullOption = PULL_DISABLE_PUEN2_BIT23
          PortPinPullControl = PULL_DOWN_PUD2_BIT23
        PortPin14:
          PortPinDirectionChangeable = false
          PortPinDioAltModeChangeable = true
          PortPinModeChangeable = false
          PortPinPolaritySelect = PORT_PIN_POSITIVE_LOGIC
          PortPinOutDataSelect = PORT_PIN_OUTDT
          PortPinLevelValue = PORT_PIN_LEVEL_LOW
          PortPinSensitiveInterrupt = PORT_PIN_LEVEL_SENSITIVE
          PortPinDetectionInterrupt = PORT_PIN_ONE_EDGE
          PortPinInitialMode = INTERRUPT
          PortPinDirection = PORT_PIN_IN
          PortPinPullOption = PULL_ENABLE_PUEN2_BIT24
          PortPinPullControl = PULL_UP_PUD2_BIT24
        PortPin15:
          PortPinDirectionChangeable = false
          PortPinDioAltModeChangeable = true
          PortPinModeChangeable = false
          PortPinPolaritySelect = PORT_PIN_POSITIVE_LOGIC
          PortPinOutDataSelect = PORT_PIN_OUTDT
          PortPinLevelValue = PORT_PIN_LEVEL_LOW
          PortPinSensitiveInterrupt = PORT_PIN_LEVEL_SENSITIVE
          PortPinDetectionInterrupt = PORT_PIN_ONE_EDGE
          PortPinInitialMode = INTERRUPT
          PortPinDirection = PORT_PIN_IN
          PortPinPullOption = PULL_ENABLE_PUEN2_BIT25
          PortPinPullControl = PULL_UP_PUD2_BIT25
    PortGeneral:
      PortDevErrorDetect = true
      PortSetPinDirectionApi = true
      PortSetPinDefaultDirectionApi = true
      PortSetPinModeApi = true
      PortSetPinDefaultModeApi = true
      PortVersionInfoApi = true
      PortVersionCheckExternalModules = true
      PortDeviceName = RCar_M3N
      PortCriticalSectionProtection = true
      PortMaxMode = 13
      PortSetToDioAltModeApi = true
      PortConfigurationRegisterCheckApi = RFSO_0
      PortWriteVerifyCheck = RFSO_2
      PortExclusiveControl = true
      PortExclusiveTimeout = 20
      PortExclusiveSelection0 = MFISLCKR0
      PortExclusiveSelection1 = MFISLCKR1
      PortFUSEMonitoringApi = RFSO_1
      PortFUSEMONExpectedValue = 20
    PortDemEventParameterRefs:
      PORT_E_WRITE_VERIFY_FAILURE = DemEventParameter1
      PORT_E_GET_CONTROL_FAILURE = DemEventParameter0
      PORT_E_CONFIGURATION_CHECK_TRANSIENT_FAILURE = DemEventParameter2
      PORT_E_CONFIGURATION_CHECK_PERMANENT_FAILURE = DemEventParameter3
      PORT_E_FUSE_MONITORING_FAILURE = DemEventParameter4
