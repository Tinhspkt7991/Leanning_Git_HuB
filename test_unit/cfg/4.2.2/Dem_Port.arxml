AUTOSAR XML (schema 4-2-2)
package /ActiveEcuC
  module config Dem: implementation-config-variant=VARIANT-PRE-COMPILE
    DemConfigSet
      10 x DemEventParameter, all with DemEventKind=, DemMaxNumberFreezeFrameRecords=, DemDTCClassRef=(unset), DemExtendedDataClassRef=(unset), DemFreezeFrameClassRef=(unset), DemFreezeFrameRecNumClassRef=(unset):
        DemEventParameter0: DemEventId=1
        DemEventParameter1: DemEventId=2
        DemEventParameter2: DemEventId=3
        DemEventParameter3: DemEventId=4
        DemEventParameter4: DemEventId=4
        PORT_E_GET_CONTROL_FAILURE: DemEventId=5
        PORT_E_WRITE_VERIFY_FAILURE: DemEventId=6
        PORT_E_CONFIGURATION_CHECK_TRANSIENT_FAILURE: DemEventId=7
        PORT_E_CONFIGURATION_CHECK_PERMANENT_FAILURE: DemEventId=8
        PORT_E_FUSE_MONITORING_FAILURE: DemEventId=9
    DemGeneral:
      DemAgingCycleCounterProcessing = 
      DemBswErrorBufferSize = 
      DemClearDTCBehavior = 
      DemDTCSuppressionSupport = false
      DemDebounceCounterBasedSupport = false
      DemDebounceTimeBasedSupport = false
      DemDevErrorDetect = false
      DemDtcStatusAvailabilityMask = 
      DemEnableConditionSupport = false
      DemEventCombinationSupport = 
      DemEventDisplacementSupport = false
      DemExtendedDataCapture = 
      DemFreezeFrameCapture = 
      DemHeaderFileInclusion = 
      DemImmediateNvStorageLimit = 
      DemMaxNumberEventEntryMirror = 
      DemMaxNumberEventEntryPermanent = 
      DemMaxNumberEventEntryPrimary = 
      DemMaxNumberEventEntrySecondary = 
      DemMaxNumberPrestoredFF = 
      DemOBDSupport = false
      DemOccurrenceCounterProcessing = 
      DemOperationCycleStatusStorage = false
      DemPTOSupport = false
      DemStatusBitStorageTestFailed = false
      DemStorageConditionSupport = false
      DemTaskTime = 
      DemTriggerDcmReports = false
      DemTriggerDltReports = false
      DemTriggerFiMReports = false
      DemTriggerMonitorInitBeforeClearOk = false
      DemTypeOfDTCSupported = 
      DemTypeOfFreezeFrameRecordNumeration = 
      DemVersionInfoApi = false
      DemMILIndicatorRef = (unset)
